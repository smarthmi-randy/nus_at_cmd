## drivers/sensor/atmel/m90e26/Kconfig
```kconfig
config M90E26_UART_DRIVER
    bool "Atmel M90E26 UART RTIO Driver"
    default y
    help
      Enable the custom RTIO UART driver for the M90E26 sensor.
```

## tests/value_reporter/testcase.yaml
```yaml
tests:
  # 測試案例的唯一名稱
  unit_test.value_reporter:
    # 標籤，方便分類和篩選
    tags: value_reporter unit
    # 說明這是一個 ztest 測試
    type: ztest
    # 建議在 native_sim 平台上執行純單元測試，速度最快且無需硬體
    platform_allow: native_sim/native/64, nrf54l15dk

#west build -b native_sim/native/64 --no-sysbuild -d ./build --pristine -- -DCONF_FILE="./prj.conf"  ./
```
